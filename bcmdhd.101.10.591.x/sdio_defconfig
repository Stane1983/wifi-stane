## bcmdhd.101.10.591.x/sdio_defconfig
```kconfig
CONFIG_BCMDHD_SDIO=y
CONFIG_ANDROID_14=y
CONFIG_BCMDHD_OOB=y
CONFIG_BCMDHD_PROPTXSTATUS=y
CONFIG_DHD_USE_STATIC_BUF=y
CONFIG_BCMDHD_STATIC_BUF_IN_KERNEL=y
CONFIG_BCMDHD_AUTO_SELECT=y
CONFIG_BCMDHD_DEBUG=y
CONFIG_BCMDHD_TPUT=y
CONFIG_MACH_PLATFORM=y
CONFIG_BCMDHD_NO_POWER_OFF=y
```
